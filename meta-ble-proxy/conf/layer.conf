## meta-ble-proxy/conf/layer.conf
```bitbake
# meta-hello-world layer configuration
BBPATH .= ":${LAYERDIR}"
BBFILES += "${LAYERDIR}/recipes-*/*/*.bb ${LAYERDIR}/recipes-*/*/*.bbappend"
BBFILE_COLLECTIONS += "bleproxy"
BBFILE_PATTERN_bleproxy = "^${LAYERDIR}/"
BBFILE_PRIORITY_bleproxy = "6"
LAYERSERIES_COMPAT_bleproxy = "dunfell"
LAYERDEPENDS_bleproxy = "core"
```

## meta-blegattserver/conf/layer.conf
```bitbake
# meta-gattserever layer configuration
# meta-gattserever/layer.conf

BBPATH .= ":${LAYERDIR}"
BBFILES += "${LAYERDIR}/recipes-*/*/*.bb ${LAYERDIR}/recipes-*/*/*.bbappend"
BBFILE_COLLECTIONS += "blegattserver"
BBFILE_PATTERN_blegattserver = "^${LAYERDIR}/"
BBFILE_PRIORITY_blegattserver = "6"
LAYERSERIES_COMPAT_blegattserver = "dunfell"
LAYERDEPENDS_blegattserver = "core"
```

## meta-cloud-endpoint/conf/layer.conf
```bitbake
# meta-hello-world layer configuration
BBPATH .= ":${LAYERDIR}"
BBFILES += "${LAYERDIR}/recipes-*/*/*.bb ${LAYERDIR}/recipes-*/*/*.bbappend"
BBFILE_COLLECTIONS += "cloudendpoint"
BBFILE_PATTERN_cloudendpoint = "^${LAYERDIR}/"
BBFILE_PRIORITY_cloudendpoint = "6"
LAYERSERIES_COMPAT_cloudendpoint = "dunfell"
LAYERDEPENDS_cloudendpoint = "core"
```

## meta-edgeimp/conf/layer.conf
```bitbake
BBPATH .= ":${LAYERDIR}"
BBFILES += "${LAYERDIR}/recipes-*/*/*.bb ${LAYERDIR}/recipes-*/*/*.bbappend"
BBFILE_COLLECTIONS += "edgeimp"
BBFILE_PATTERN_edgeimp = "^${LAYERDIR}/"
BBFILE_PRIORITY_edgeimp = "6"

LAYERSERIES_COMPAT_edgeimp = "dunfell"

LAYERDEPENDS_edgeimp = "core"
```

## meta-esp32/conf/layer.conf
```bitbake
# meta-esp32 layer configuration
# meta-esp32/conf/layer.conf

# We have a conf and classes directory, add to BBPATH
BBPATH .= ":${LAYERDIR}"

# We have recipes-* directories, add to BBFILES
BBFILES += "${LAYERDIR}/recipes-*/*/*.bb \
            ${LAYERDIR}/recipes-*/*/*.bbappend"

BBFILE_COLLECTIONS += "esp-hosted"
BBFILE_PATTERN_esp-hosted = "^${LAYERDIR}/"

BBFILE_PRIORITY_esp-hosted = "6"
LAYERSERIES_COMPAT_esp-hosted = "dunfell"

LAYERDEPENDS_esp-hosted = "core"
LAYER_SUMMARY_esp-hosted = "ESP-Hosted solution"
LAYER_DESCRIPTION_esp-hosted = "Integrating ESP-Hosted solution into RZ/V2L VLP 3.0.4 yocto to use ESP board as a communication processor i.e. host for Wi-Fi and Bluetooth/BLE connectivity"
```

## meta-harvest/conf/layer.conf
```bitbake
# meta-harvest layer configuration
# meta-harvest/layer.conf

BBPATH .= ":${LAYERDIR}"
BBFILES += "${LAYERDIR}/recipes-*/*/*.bb ${LAYERDIR}/recipes-*/*/*.bbappend"
BBFILE_COLLECTIONS += "harvest"
BBFILE_PATTERN_harvest = "^${LAYERDIR}/"
BBFILE_PRIORITY_harvest = "6"
LAYERSERIES_COMPAT_harvest = "dunfell"
LAYERDEPENDS_harvest = "core"
```

## meta-mic/conf/layer.conf
```bitbake
# meta-videostream layer configuration
BBPATH .= ":${LAYERDIR}"
BBFILES += "${LAYERDIR}/recipes-*/*/*.bb ${LAYERDIR}/recipes-*/*/*.bbappend"
BBFILE_COLLECTIONS += "mic"
BBFILE_PATTERN_mic = "^${LAYERDIR}/"
BBFILE_PRIORITY_mic = "6"
LAYERDEPENDS_mic = "core"
LAYERSERIES_COMPAT_mic = "dunfell"
```

## meta-radar/conf/layer.conf
```bitbake
# meta-radar layer configuration
BBPATH .= ":${LAYERDIR}"
BBFILES += "${LAYERDIR}/recipes-*/*/*.bb ${LAYERDIR}/recipes-*/*/*.bbappend"
BBFILE_COLLECTIONS += "radar"
BBFILE_PATTERN_radar = "^${LAYERDIR}/"
BBFILE_PRIORITY_radar = "6"
LAYERDEPENDS_radar = "core"
LAYERSERIES_COMPAT_radar = "dunfell"
```

## meta-receivermsg/conf/layer.conf
```bitbake
# meta-receivermsg layer configuration
BBPATH .= ":${LAYERDIR}"
BBFILES += "${LAYERDIR}/recipes-*/*/*.bb ${LAYERDIR}/recipes-*/*/*.bbappend"
BBFILE_COLLECTIONS += "receivermsg"
BBFILE_PATTERN_receivermsg = "^${LAYERDIR}/"
BBFILE_PRIORITY_receivermsg = "6"
LAYERSERIES_COMPAT_receivermsg = "dunfell"
LAYERDEPENDS_receivermsg = "core"
```

## meta-receivermsg2/conf/layer.conf
```bitbake
# meta-receivermsg layer configuration
BBPATH .= ":${LAYERDIR}"
BBFILES += "${LAYERDIR}/recipes-*/*/*.bb ${LAYERDIR}/recipes-*/*/*.bbappend"
BBFILE_COLLECTIONS += "receivermsg2"
BBFILE_PATTERN_receivermsg2 = "^${LAYERDIR}/"
BBFILE_PRIORITY_receivermsg2 = "6"
LAYERSERIES_COMPAT_receivermsg2 = "dunfell"
LAYERDEPENDS_receivermsg2 = "core"
```

## meta-rz-features/meta-rz-multi-os/meta-rzv2l/conf/layer.conf
```bitbake
# We have a conf and classes directory, add to BBPATH
BBPATH .= ":${LAYERDIR}"

include ${LAYERDIR}/include/openamp.inc

# We have recipes-* directories, add to BBFILES
BBFILES += "${LAYERDIR}/recipes-*/*/*.bb \
            ${LAYERDIR}/recipes-*/*/*.bbappend"
	
BBFILE_COLLECTIONS += "rz-multi-os"
BBFILE_PATTERN_rz-multi-os := "^${LAYERDIR}/"

LAYERDEPENDS_rz-multi-os = "rz-common"
LAYERSERIES_COMPAT_rz-multi-os = "dunfell"
```

## meta-sendermsg/conf/layer.conf
```bitbake
# meta-receivermsg layer configuration
BBPATH .= ":${LAYERDIR}"
BBFILES += "${LAYERDIR}/recipes-*/*/*.bb ${LAYERDIR}/recipes-*/*/*.bbappend"
BBFILE_COLLECTIONS += "sendermsg"
BBFILE_PATTERN_sendermsg = "^${LAYERDIR}/"
BBFILE_PRIORITY_sendermsg = "6"
LAYERSERIES_COMPAT_sendermsg = "dunfell"
LAYERDEPENDS_sendermsg = "core"
```

## meta-videostream/conf/layer.conf
```bitbake
# meta-videostream layer configuration
BBPATH .= ":${LAYERDIR}"
BBFILES += "${LAYERDIR}/recipes-*/*/*.bb ${LAYERDIR}/recipes-*/*/*.bbappend"
BBFILE_COLLECTIONS += "videostream"
BBFILE_PATTERN_videostream = "^${LAYERDIR}/"
BBFILE_PRIORITY_videostream = "6"

LAYERDEPENDS_videostream = "core"
LAYERSERIES_COMPAT_videostream = "dunfell"
```
